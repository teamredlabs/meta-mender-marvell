## meta-mender-marvell-cb-88f3720-ddr3-espressobin/conf/layer.conf
```bitbake
# Board specific layer configuration for meta-mender
# Copyright 2018 John Lawrence M. Penafiel

# We have a conf and classes directory, add to BBPATH
BBPATH .= ":${LAYERDIR}"

# We have recipes-* directories, add to BBFILES
BBFILES += "${LAYERDIR}/recipes-*/*/*.bb \
    ${LAYERDIR}/recipes-*/*/*.bbappend"

BBFILE_COLLECTIONS += "mender-cb-88f3720-ddr3-espressobin"
BBFILE_PATTERN_mender-cb-88f3720-ddr3-espressobin = "^${LAYERDIR}/"
BBFILE_PRIORITY_mender-cb-88f3720-ddr3-espressobin = "10"
```
